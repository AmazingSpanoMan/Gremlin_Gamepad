## Gremlin_v3/config/west.yml
```yaml
manifest:
  remotes:
    - name: zmkfirmware
      url-base: https://github.com/zmkfirmware
    - name: wdtamagi
      url-base: https://github.com/wdtamagi
  projects:
    - name: zmk
      remote: zmkfirmware
      revision: main
      import: app/west.yml
    - name: zmk-driver-analog-stick
      remote: wdtamagi
      revision: main
  self:
    path: config
```

## boards/shields/gremlinv3/Kconfig.defconfig
```kconfig
if SHIELD_GREMLINV3

config ZMK_KEYBOARD_NAME
    default "Gremlin v3"

config LV_Z_VDB_SIZE
    default 100

config LV_DPI_DEF
    default 161

config LV_Z_BITS_PER_PIXEL
    default 1

choice LV_COLOR_DEPTH
    default LV_COLOR_DEPTH_1
endchoice

endif
```

## config/west.yml
```yaml
manifest:
  remotes:
    - name: zmkfirmware
      url-base: https://github.com/zmkfirmware
    - name: wdtamagi
      url-base: https://github.com/wdtamagi
  projects:
    - name: zmk
      remote: zmkfirmware
      revision: v0.3
      import: app/west.yml
    - name: zmk-driver-analog-stick
      remote: wdtamagi
      revision: main
  self:
    path: config
```
