## config/west.yml
```yaml
manifest:
  remotes:
    - name: zmkfirmware
      url-base: https://github.com/zmkfirmware
    - name: amazingspanoman
      url-base: https://github.com/AmazingSpanoMan
  projects:
    - name: zmk
      remote: amazingspanoman
      revision: gremlin-v0.3
      import: app/west.yml
    - name: zmk-driver-analog-stick
      remote: amazingspanoman
      revision: gremlin
  self:
    path: config
```
